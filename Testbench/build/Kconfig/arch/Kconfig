## Testbench/build/Kconfig/arch/Kconfig
```kconfig
# Load Zephyr Arch Kconfig descriptions.
osource "/media/gemy/Linux_Workspace/ITI/Zypher_WS/zephyrproject/zephyr/arch/rx/Kconfig"
osource "/media/gemy/Linux_Workspace/ITI/Zypher_WS/zephyrproject/zephyr/arch/x86/Kconfig"
osource "/media/gemy/Linux_Workspace/ITI/Zypher_WS/zephyrproject/zephyr/arch/xtensa/Kconfig"
osource "/media/gemy/Linux_Workspace/ITI/Zypher_WS/zephyrproject/zephyr/arch/sparc/Kconfig"
osource "/media/gemy/Linux_Workspace/ITI/Zypher_WS/zephyrproject/zephyr/arch/riscv/Kconfig"
osource "/media/gemy/Linux_Workspace/ITI/Zypher_WS/zephyrproject/zephyr/arch/posix/Kconfig"
osource "/media/gemy/Linux_Workspace/ITI/Zypher_WS/zephyrproject/zephyr/arch/openrisc/Kconfig"
osource "/media/gemy/Linux_Workspace/ITI/Zypher_WS/zephyrproject/zephyr/arch/mips/Kconfig"
osource "/media/gemy/Linux_Workspace/ITI/Zypher_WS/zephyrproject/zephyr/arch/arm64/Kconfig"
osource "/media/gemy/Linux_Workspace/ITI/Zypher_WS/zephyrproject/zephyr/arch/arm/Kconfig"
osource "/media/gemy/Linux_Workspace/ITI/Zypher_WS/zephyrproject/zephyr/arch/arc/Kconfig"
```

## Testbench/build/Kconfig/boards/Kconfig.defconfig
```kconfig
# Load Zephyr board defconfig descriptions.
osource "/media/gemy/Linux_Workspace/ITI/Zypher_WS/zephyrproject/zephyr/boards/weact/esp32s3_mini/Kconfig.defconfig"
```

## Testbench/build/Kconfig/boards/Kconfig.sysbuild
```kconfig
# Load Sysbuild board Kconfig descriptions.
osource "/media/gemy/Linux_Workspace/ITI/Zypher_WS/zephyrproject/zephyr/boards/weact/esp32s3_mini/Kconfig.sysbuild"
```

## Testbench/build/Kconfig/boards/Kconfig.weact_esp32s3_mini
```kconfig
# Load board Kconfig descriptions.
osource "/media/gemy/Linux_Workspace/ITI/Zypher_WS/zephyrproject/zephyr/boards/weact/esp32s3_mini/Kconfig.weact_esp32s3_mini"
```

## Testbench/build/Kconfig/soc/Kconfig.defconfig
```kconfig
# Load Zephyr SoC defconfig descriptions.
osource "/media/gemy/Linux_Workspace/ITI/Zypher_WS/zephyrproject/zephyr/soc/xlnx/zynqmp/Kconfig.defconfig"
osource "/media/gemy/Linux_Workspace/ITI/Zypher_WS/zephyrproject/zephyr/soc/xlnx/zynq7000/Kconfig.defconfig"
osource "/media/gemy/Linux_Workspace/ITI/Zypher_WS/zephyrproject/zephyr/soc/xlnx/versalnet/Kconfig.defconfig"
osource "/media/gemy/Linux_Workspace/ITI/Zypher_WS/zephyrproject/zephyr/soc/xlnx/versal2/Kconfig.defconfig"
osource "/media/gemy/Linux_Workspace/ITI/Zypher_WS/zephyrproject/zephyr/soc/xlnx/versal/Kconfig.defconfig"
osource "/media/gemy/Linux_Workspace/ITI/Zypher_WS/zephyrproject/zephyr/soc/xen/Kconfig.defconfig"
osource "/media/gemy/Linux_Workspace/ITI/Zypher_WS/zephyrproject/zephyr/soc/wch/ch32v/Kconfig.defconfig"
osource "/media/gemy/Linux_Workspace/ITI/Zypher_WS/zephyrproject/zephyr/soc/ti/simplelink/Kconfig.defconfig"
osource "/media/gemy/Linux_Workspace/ITI/Zypher_WS/zephyrproject/zephyr/soc/ti/mspm0/Kconfig.defconfig"
osource "/media/gemy/Linux_Workspace/ITI/Zypher_WS/zephyrproject/zephyr/soc/ti/lm3s6965/Kconfig.defconfig"
osource "/media/gemy/Linux_Workspace/ITI/Zypher_WS/zephyrproject/zephyr/soc/ti/k3/Kconfig.defconfig"
osource "/media/gemy/Linux_Workspace/ITI/Zypher_WS/zephyrproject/zephyr/soc/telink/tlsr/Kconfig.defconfig"
osource "/media/gemy/Linux_Workspace/ITI/Zypher_WS/zephyrproject/zephyr/soc/syna/sr100/Kconfig.defconfig"
osource "/media/gemy/Linux_Workspace/ITI/Zypher_WS/zephyrproject/zephyr/soc/starfive/jh71xx/Kconfig.defconfig"
osource "/media/gemy/Linux_Workspace/ITI/Zypher_WS/zephyrproject/zephyr/soc/st/stm32/Kconfig.defconfig"
osource "/media/gemy/Linux_Workspace/ITI/Zypher_WS/zephyrproject/zephyr/soc/snps/qemu_arc/Kconfig.defconfig"
osource "/media/gemy/Linux_Workspace/ITI/Zypher_WS/zephyrproject/zephyr/soc/snps/nsim/arc_v/Kconfig.defconfig"
osource "/media/gemy/Linux_Workspace/ITI/Zypher_WS/zephyrproject/zephyr/soc/snps/nsim/arc_classic/Kconfig.defconfig"
osource "/media/gemy/Linux_Workspace/ITI/Zypher_WS/zephyrproject/zephyr/soc/snps/hsdk4xd/Kconfig.defconfig"
osource "/media/gemy/Linux_Workspace/ITI/Zypher_WS/zephyrproject/zephyr/soc/snps/hsdk/Kconfig.defconfig"
osource "/media/gemy/Linux_Workspace/ITI/Zypher_WS/zephyrproject/zephyr/soc/snps/emsk/Kconfig.defconfig"
osource "/media/gemy/Linux_Workspace/ITI/Zypher_WS/zephyrproject/zephyr/soc/snps/emsdp/Kconfig.defconfig"
osource "/media/gemy/Linux_Workspace/ITI/Zypher_WS/zephyrproject/zephyr/soc/snps/arc_iot/Kconfig.defconfig"
osource "/media/gemy/Linux_Workspace/ITI/Zypher_WS/zephyrproject/zephyr/soc/silabs/Kconfig.defconfig"
osource "/media/gemy/Linux_Workspace/ITI/Zypher_WS/zephyrproject/zephyr/soc/sifli/sf32/Kconfig.defconfig"
osource "/media/gemy/Linux_Workspace/ITI/Zypher_WS/zephyrproject/zephyr/soc/sifive/sifive_freedom/Kconfig.defconfig"
osource "/media/gemy/Linux_Workspace/ITI/Zypher_WS/zephyrproject/zephyr/soc/sensry/Kconfig.defconfig"
osource "/media/gemy/Linux_Workspace/ITI/Zypher_WS/zephyrproject/zephyr/soc/rockchip/Kconfig.defconfig"
osource "/media/gemy/Linux_Workspace/ITI/Zypher_WS/zephyrproject/zephyr/soc/renode/riscv_virtual/Kconfig.defconfig"
osource "/media/gemy/Linux_Workspace/ITI/Zypher_WS/zephyrproject/zephyr/soc/renode/cortex_r8_virtual/Kconfig.defconfig"
osource "/media/gemy/Linux_Workspace/ITI/Zypher_WS/zephyrproject/zephyr/soc/renesas/smartbond/Kconfig.defconfig"
osource "/media/gemy/Linux_Workspace/ITI/Zypher_WS/zephyrproject/zephyr/soc/renesas/rz/Kconfig.defconfig"
osource "/media/gemy/Linux_Workspace/ITI/Zypher_WS/zephyrproject/zephyr/soc/renesas/rx/Kconfig.defconfig"
osource "/media/gemy/Linux_Workspace/ITI/Zypher_WS/zephyrproject/zephyr/soc/renesas/rcar/Kconfig.defconfig"
osource "/media/gemy/Linux_Workspace/ITI/Zypher_WS/zephyrproject/zephyr/soc/renesas/ra/Kconfig.defconfig"
osource "/media/gemy/Linux_Workspace/ITI/Zypher_WS/zephyrproject/zephyr/soc/realtek/fingerprint/Kconfig.defconfig"
osource "/media/gemy/Linux_Workspace/ITI/Zypher_WS/zephyrproject/zephyr/soc/realtek/ec/Kconfig.defconfig"
osource "/media/gemy/Linux_Workspace/ITI/Zypher_WS/zephyrproject/zephyr/soc/realtek/bee/Kconfig.defconfig"
osource "/media/gemy/Linux_Workspace/ITI/Zypher_WS/zephyrproject/zephyr/soc/realtek/ameba/Kconfig.defconfig"
osource "/media/gemy/Linux_Workspace/ITI/Zypher_WS/zephyrproject/zephyr/soc/raspberrypi/rpi_pico/Kconfig.defconfig"
osource "/media/gemy/Linux_Workspace/ITI/Zypher_WS/zephyrproject/zephyr/soc/quicklogic/eos_s3/Kconfig.defconfig"
osource "/media/gemy/Linux_Workspace/ITI/Zypher_WS/zephyrproject/zephyr/soc/qemu/virt_riscv/Kconfig.defconfig"
osource "/media/gemy/Linux_Workspace/ITI/Zypher_WS/zephyrproject/zephyr/soc/qemu/or1k/Kconfig.defconfig"
osource "/media/gemy/Linux_Workspace/ITI/Zypher_WS/zephyrproject/zephyr/soc/qemu/malta/Kconfig.defconfig"
osource "/media/gemy/Linux_Workspace/ITI/Zypher_WS/zephyrproject/zephyr/soc/openisa/rv32m1/Kconfig.defconfig"
osource "/media/gemy/Linux_Workspace/ITI/Zypher_WS/zephyrproject/zephyr/soc/openhwgroup/cva6/Kconfig.defconfig"
osource "/media/gemy/Linux_Workspace/ITI/Zypher_WS/zephyrproject/zephyr/soc/oct/osd32mp15x/Kconfig.defconfig"
osource "/media/gemy/Linux_Workspace/ITI/Zypher_WS/zephyrproject/zephyr/soc/nxp/s32/Kconfig.defconfig"
osource "/media/gemy/Linux_Workspace/ITI/Zypher_WS/zephyrproject/zephyr/soc/nxp/rw/Kconfig.defconfig"
osource "/media/gemy/Linux_Workspace/ITI/Zypher_WS/zephyrproject/zephyr/soc/nxp/mcx/Kconfig.defconfig"
osource "/media/gemy/Linux_Workspace/ITI/Zypher_WS/zephyrproject/zephyr/soc/nxp/lpc/Kconfig.defconfig"
osource "/media/gemy/Linux_Workspace/ITI/Zypher_WS/zephyrproject/zephyr/soc/nxp/layerscape/Kconfig.defconfig"
osource "/media/gemy/Linux_Workspace/ITI/Zypher_WS/zephyrproject/zephyr/soc/nxp/kinetis/Kconfig.defconfig"
osource "/media/gemy/Linux_Workspace/ITI/Zypher_WS/zephyrproject/zephyr/soc/nxp/imxrt/Kconfig.defconfig"
osource "/media/gemy/Linux_Workspace/ITI/Zypher_WS/zephyrproject/zephyr/soc/nxp/imx/Kconfig.defconfig"
osource "/media/gemy/Linux_Workspace/ITI/Zypher_WS/zephyrproject/zephyr/soc/nuvoton/numicro/Kconfig.defconfig"
osource "/media/gemy/Linux_Workspace/ITI/Zypher_WS/zephyrproject/zephyr/soc/nuvoton/numaker/Kconfig.defconfig"
osource "/media/gemy/Linux_Workspace/ITI/Zypher_WS/zephyrproject/zephyr/soc/nuvoton/npcx/Kconfig.defconfig"
osource "/media/gemy/Linux_Workspace/ITI/Zypher_WS/zephyrproject/zephyr/soc/nuvoton/npcm/Kconfig.defconfig"
osource "/media/gemy/Linux_Workspace/ITI/Zypher_WS/zephyrproject/zephyr/soc/nordic/Kconfig.defconfig"
osource "/media/gemy/Linux_Workspace/ITI/Zypher_WS/zephyrproject/zephyr/soc/neorv32/Kconfig.defconfig"
osource "/media/gemy/Linux_Workspace/ITI/Zypher_WS/zephyrproject/zephyr/soc/native/inf_clock/Kconfig.defconfig"
osource "/media/gemy/Linux_Workspace/ITI/Zypher_WS/zephyrproject/zephyr/soc/microchip/sam/sama7/Kconfig.defconfig"
osource "/media/gemy/Linux_Workspace/ITI/Zypher_WS/zephyrproject/zephyr/soc/microchip/sam/sam_d5x_e5x/Kconfig.defconfig"
osource "/media/gemy/Linux_Workspace/ITI/Zypher_WS/zephyrproject/zephyr/soc/microchip/pic64/Kconfig.defconfig"
osource "/media/gemy/Linux_Workspace/ITI/Zypher_WS/zephyrproject/zephyr/soc/microchip/pic32c/pic32cz_ca/Kconfig.defconfig"
osource "/media/gemy/Linux_Workspace/ITI/Zypher_WS/zephyrproject/zephyr/soc/microchip/pic32c/pic32cx_sg/Kconfig.defconfig"
osource "/media/gemy/Linux_Workspace/ITI/Zypher_WS/zephyrproject/zephyr/soc/microchip/pic32c/pic32cm_pl/Kconfig.defconfig"
osource "/media/gemy/Linux_Workspace/ITI/Zypher_WS/zephyrproject/zephyr/soc/microchip/pic32c/pic32cm_jh/Kconfig.defconfig"
osource "/media/gemy/Linux_Workspace/ITI/Zypher_WS/zephyrproject/zephyr/soc/microchip/miv/Kconfig.defconfig"
osource "/media/gemy/Linux_Workspace/ITI/Zypher_WS/zephyrproject/zephyr/soc/microchip/mec/Kconfig.defconfig"
osource "/media/gemy/Linux_Workspace/ITI/Zypher_WS/zephyrproject/zephyr/soc/mediatek/mt8xxx/Kconfig.defconfig"
osource "/media/gemy/Linux_Workspace/ITI/Zypher_WS/zephyrproject/zephyr/soc/lowrisc/opentitan/Kconfig.defconfig"
osource "/media/gemy/Linux_Workspace/ITI/Zypher_WS/zephyrproject/zephyr/soc/litex/litex_vexriscv/Kconfig.defconfig"
osource "/media/gemy/Linux_Workspace/ITI/Zypher_WS/zephyrproject/zephyr/soc/ite/ec/Kconfig.defconfig"
osource "/media/gemy/Linux_Workspace/ITI/Zypher_WS/zephyrproject/zephyr/soc/intel/wildcat_lake/Kconfig.defconfig"
osource "/media/gemy/Linux_Workspace/ITI/Zypher_WS/zephyrproject/zephyr/soc/intel/raptor_lake/Kconfig.defconfig"
osource "/media/gemy/Linux_Workspace/ITI/Zypher_WS/zephyrproject/zephyr/soc/intel/panther_lake/Kconfig.defconfig"
osource "/media/gemy/Linux_Workspace/ITI/Zypher_WS/zephyrproject/zephyr/soc/intel/lakemont/Kconfig.defconfig"
osource "/media/gemy/Linux_Workspace/ITI/Zypher_WS/zephyrproject/zephyr/soc/intel/intel_socfpga_std/Kconfig.defconfig"
osource "/media/gemy/Linux_Workspace/ITI/Zypher_WS/zephyrproject/zephyr/soc/intel/intel_socfpga/Kconfig.defconfig"
osource "/media/gemy/Linux_Workspace/ITI/Zypher_WS/zephyrproject/zephyr/soc/intel/intel_niosv/Kconfig.defconfig"
osource "/media/gemy/Linux_Workspace/ITI/Zypher_WS/zephyrproject/zephyr/soc/intel/intel_ish/Kconfig.defconfig"
osource "/media/gemy/Linux_Workspace/ITI/Zypher_WS/zephyrproject/zephyr/soc/intel/intel_adsp/Kconfig.defconfig"
osource "/media/gemy/Linux_Workspace/ITI/Zypher_WS/zephyrproject/zephyr/soc/intel/elkhart_lake/Kconfig.defconfig"
osource "/media/gemy/Linux_Workspace/ITI/Zypher_WS/zephyrproject/zephyr/soc/intel/atom/Kconfig.defconfig"
osource "/media/gemy/Linux_Workspace/ITI/Zypher_WS/zephyrproject/zephyr/soc/intel/apollo_lake/Kconfig.defconfig"
osource "/media/gemy/Linux_Workspace/ITI/Zypher_WS/zephyrproject/zephyr/soc/intel/alder_lake/Kconfig.defconfig"
osource "/media/gemy/Linux_Workspace/ITI/Zypher_WS/zephyrproject/zephyr/soc/infineon/psoc4/Kconfig.defconfig"
osource "/media/gemy/Linux_Workspace/ITI/Zypher_WS/zephyrproject/zephyr/soc/infineon/edge/Kconfig.defconfig"
osource "/media/gemy/Linux_Workspace/ITI/Zypher_WS/zephyrproject/zephyr/soc/infineon/cat3/Kconfig.defconfig"
osource "/media/gemy/Linux_Workspace/ITI/Zypher_WS/zephyrproject/zephyr/soc/infineon/cat1c/Kconfig.defconfig"
osource "/media/gemy/Linux_Workspace/ITI/Zypher_WS/zephyrproject/zephyr/soc/infineon/cat1b/Kconfig.defconfig"
osource "/media/gemy/Linux_Workspace/ITI/Zypher_WS/zephyrproject/zephyr/soc/infineon/cat1a/Kconfig.defconfig"
osource "/media/gemy/Linux_Workspace/ITI/Zypher_WS/zephyrproject/zephyr/soc/gd/gd32/Kconfig.defconfig"
osource "/media/gemy/Linux_Workspace/ITI/Zypher_WS/zephyrproject/zephyr/soc/gaisler/leon3/Kconfig.defconfig"
osource "/media/gemy/Linux_Workspace/ITI/Zypher_WS/zephyrproject/zephyr/soc/gaisler/gr716a/Kconfig.defconfig"
osource "/media/gemy/Linux_Workspace/ITI/Zypher_WS/zephyrproject/zephyr/soc/focaltech/Kconfig.defconfig"
osource "/media/gemy/Linux_Workspace/ITI/Zypher_WS/zephyrproject/zephyr/soc/espressif/Kconfig.defconfig"
osource "/media/gemy/Linux_Workspace/ITI/Zypher_WS/zephyrproject/zephyr/soc/ene/kb1200/Kconfig.defconfig"
osource "/media/gemy/Linux_Workspace/ITI/Zypher_WS/zephyrproject/zephyr/soc/ene/kb106x/Kconfig.defconfig"
osource "/media/gemy/Linux_Workspace/ITI/Zypher_WS/zephyrproject/zephyr/soc/elan/em32f967/Kconfig.defconfig"
osource "/media/gemy/Linux_Workspace/ITI/Zypher_WS/zephyrproject/zephyr/soc/egis/Kconfig.defconfig"
osource "/media/gemy/Linux_Workspace/ITI/Zypher_WS/zephyrproject/zephyr/soc/efinix/sapphire/Kconfig.defconfig"
osource "/media/gemy/Linux_Workspace/ITI/Zypher_WS/zephyrproject/zephyr/soc/cdns/xtensa_sample_controller/Kconfig.defconfig"
osource "/media/gemy/Linux_Workspace/ITI/Zypher_WS/zephyrproject/zephyr/soc/cdns/swerv/Kconfig.defconfig"
osource "/media/gemy/Linux_Workspace/ITI/Zypher_WS/zephyrproject/zephyr/soc/cdns/sample_controller32/Kconfig.defconfig"
osource "/media/gemy/Linux_Workspace/ITI/Zypher_WS/zephyrproject/zephyr/soc/cdns/dc233c/Kconfig.defconfig"
osource "/media/gemy/Linux_Workspace/ITI/Zypher_WS/zephyrproject/zephyr/soc/brcm/bcmvk/Kconfig.defconfig"
osource "/media/gemy/Linux_Workspace/ITI/Zypher_WS/zephyrproject/zephyr/soc/brcm/bcm2712/Kconfig.defconfig"
osource "/media/gemy/Linux_Workspace/ITI/Zypher_WS/zephyrproject/zephyr/soc/brcm/bcm2711/Kconfig.defconfig"
osource "/media/gemy/Linux_Workspace/ITI/Zypher_WS/zephyrproject/zephyr/soc/blackberry/qnxhv_vm/Kconfig.defconfig"
osource "/media/gemy/Linux_Workspace/ITI/Zypher_WS/zephyrproject/zephyr/soc/bflb/Kconfig.defconfig"
osource "/media/gemy/Linux_Workspace/ITI/Zypher_WS/zephyrproject/zephyr/soc/atmel/sam0/Kconfig.defconfig"
osource "/media/gemy/Linux_Workspace/ITI/Zypher_WS/zephyrproject/zephyr/soc/atmel/sam/Kconfig.defconfig"
osource "/media/gemy/Linux_Workspace/ITI/Zypher_WS/zephyrproject/zephyr/soc/aspeed/Kconfig.defconfig"
osource "/media/gemy/Linux_Workspace/ITI/Zypher_WS/zephyrproject/zephyr/soc/arm/Kconfig.defconfig"
osource "/media/gemy/Linux_Workspace/ITI/Zypher_WS/zephyrproject/zephyr/soc/arm/beetle/Kconfig.defconfig"
osource "/media/gemy/Linux_Workspace/ITI/Zypher_WS/zephyrproject/zephyr/soc/antmicro/myra/Kconfig.defconfig"
osource "/media/gemy/Linux_Workspace/ITI/Zypher_WS/zephyrproject/zephyr/soc/andestech/Kconfig.defconfig"
osource "/media/gemy/Linux_Workspace/ITI/Zypher_WS/zephyrproject/zephyr/soc/amd/acp_6_0/Kconfig.defconfig"
osource "/media/gemy/Linux_Workspace/ITI/Zypher_WS/zephyrproject/zephyr/soc/ambiq/Kconfig.defconfig"
osource "/media/gemy/Linux_Workspace/ITI/Zypher_WS/zephyrproject/zephyr/soc/allwinner/sun8i_h3/Kconfig.defconfig"
osource "/media/gemy/Linux_Workspace/ITI/Zypher_WS/zephyrproject/zephyr/soc/alif/ensemble/Kconfig.defconfig"
osource "/media/gemy/Linux_Workspace/ITI/Zypher_WS/zephyrproject/zephyr/soc/aesc/Kconfig.defconfig"
osource "/media/gemy/Linux_Workspace/ITI/Zypher_WS/zephyrproject/zephyr/soc/adi/max32/Kconfig.defconfig"
```
